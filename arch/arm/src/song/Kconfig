## configs/banks/sensor/defconfig
```kconfig
CONFIG_16550_ADDRWIDTH=32
CONFIG_16550_REGWIDTH=32
CONFIG_16550_UART3_BASE=0xf900b000
CONFIG_16550_UART3_CLOCK=1843200
CONFIG_16550_UART3_IRQ=34
CONFIG_16550_UART3_SERIAL_CONSOLE=y
CONFIG_16550_UART3=y
CONFIG_16550_UART=y
CONFIG_ALARM_ARCH=y
CONFIG_ARCH="arm"
CONFIG_ARCH_ARM_SONG=y
CONFIG_ARCH_BOARD="banks"
CONFIG_ARCH_BOARD_BANKS=y
CONFIG_ARCH_CHIP_BANKS_SENSOR=y
CONFIG_ARCH_CHIP_SONG=y
CONFIG_ARM_MPU=y
CONFIG_ARMV7M_USEBASEPRI=y
CONFIG_BOARD_INITIALIZE=y
CONFIG_BOARD_INITTHREAD=y
CONFIG_BUILTIN=y
CONFIG_EXAMPLES_NSH=y
CONFIG_FS_BINFS=y
CONFIG_MM_REGIONS=2
CONFIG_NSH_BUILTIN_APPS=y
CONFIG_ONESHOT_SONG=y
CONFIG_ONESHOT=y
CONFIG_PM=y
CONFIG_RAW_BINARY=y
CONFIG_SCHED_HPWORK=y
CONFIG_SCHED_TICKLESS_ALARM=y
CONFIG_SCHED_TICKLESS_LIMIT_MAX_SLEEP=y
CONFIG_SCHED_TICKLESS=y
CONFIG_SERIAL_UART_ARCH_MMIO=y
CONFIG_SONG_NR_IRQS=49
CONFIG_SYSTEM_TIME64=y
CONFIG_USER_ENTRYPOINT="nsh_main"
```

## configs/banks/vision/defconfig
```kconfig
CONFIG_ARCH_BOARD="banks"
CONFIG_ARCH_BOARD_BANKS=y
CONFIG_ARCH="ceva"
CONFIG_ARCH_CEVA=y
CONFIG_ARCH_CHIP_BANKS_VDSP=y
CONFIG_ARCH_CHIP_SONG=y
CONFIG_ARCH_DTCM_SIZE=524288
CONFIG_ARCH_HARDFAULT_IRQ=4
CONFIG_ARCH_ICACHE=y
CONFIG_ARCH_ITCM_SIZE=131072
CONFIG_ARCH_MPU=y
CONFIG_ARCH_RTL_MAJOR=1
CONFIG_ARCH_RTL_MINOR=1
CONFIG_ARCH_RTL_REVISION=1
CONFIG_ARCH_STACKDUMP=y
CONFIG_ARCH_XM6_BUG001=y
CONFIG_ARCH_XM6_STACKCHECK=y
CONFIG_BANKS_VISION=y
CONFIG_BOARD_INITIALIZE=y
CONFIG_BOARD_INITTHREAD=y
CONFIG_BOOT_RUNFROMISRAM=y
CONFIG_BUILTIN=y
CONFIG_CLOCK_MONOTONIC=y
CONFIG_DEBUG_FEATURES=y
CONFIG_DEBUG_HARDFAULT=y
CONFIG_EXAMPLES_HELLO=y
CONFIG_FS_PROCFS=y
CONFIG_FS_ROMFS=y
CONFIG_HEAP_COLORATION=y
CONFIG_MEMSET_OPTSPEED=y
CONFIG_PM=y
CONFIG_RAMLOG_SYSLOG=y
CONFIG_RAMLOG=y
CONFIG_SCHED_CHILD_STATUS=y
CONFIG_SCHED_HAVE_PARENT=y
CONFIG_SCHED_HPNTHREADS=2
CONFIG_SCHED_HPWORK=y
CONFIG_SCHED_TICKLESS_LIMIT_MAX_SLEEP=y
CONFIG_SCHED_TICKLESS=y
CONFIG_SCHED_WAITPID=y
CONFIG_SIG_SIGKILL=y
CONFIG_SONG_NR_IRQS=20
CONFIG_STACK_COLORATION=y
CONFIG_SYSLOG_PREFIX_STRING="vision: "
CONFIG_SYSLOG_PREFIX=y
CONFIG_SYSLOG_TIMESTAMP=y
CONFIG_SYSTEM_CLE=y
CONFIG_SYSTEM_TIME64=y
CONFIG_TIMER_ARCH=y
CONFIG_TIMER_DW=y
CONFIG_TIMER=y
CONFIG_USER_ENTRYPOINT="hello_main"
CONFIG_VINTC_DW_BASE=0xfd030000
CONFIG_VINTC_DW=y
```

## configs/unicorn/Kconfig
```kconfig
#
# For a description of the syntax of this configuration file,
# see the file kconfig-language.txt in the NuttX tools repository.
#

choice
	prompt "Select target application"

config UNICORN_AP
	bool "Unicorn AP"

config UNICORN_CP
	bool "Unicorn CP"

config UNICORN_SP
	bool "Unicorn SP"

config UNICORN_FVP
	bool "Unicorn FVP"

config UNICORN_SIM
	bool "Unicorn SIM"

endchoice
```

## configs/unicorn/ap/defconfig
```kconfig
CONFIG_ALARM_ARCH=y
CONFIG_ARCH="arm"
CONFIG_ARCH_ARM_SONG=y
CONFIG_ARCH_BOARD="unicorn"
CONFIG_ARCH_BOARD_UNICORN=y
CONFIG_ARCH_CHIP_SONG=y
CONFIG_ARCH_CHIP_UNICORN_AP=y
CONFIG_ARCH_STACKDUMP=y
CONFIG_ARM_MPU=y
CONFIG_ARMV7M_USEBASEPRI=y
CONFIG_BOARD_INITIALIZE=y
CONFIG_BOARD_INITTHREAD=y
CONFIG_BUILTIN=y
CONFIG_CLOCK_MONOTONIC=y
CONFIG_EXAMPLES_NSH=y
CONFIG_FS_BINFS=y
CONFIG_FS_HOSTFS_RPMSG=y
CONFIG_FS_HOSTFS=y
CONFIG_FS_PROCFS=y
CONFIG_HEAP_COLORATION=y
CONFIG_MBOX=y
CONFIG_NSH_BUILTIN_APPS=y
CONFIG_NSH_PROMPT_STRING="ap> "
CONFIG_NSH_READLINE=y
CONFIG_ONESHOT_SONG=y
CONFIG_ONESHOT=y
CONFIG_OPENAMP=y
CONFIG_PM=y
CONFIG_RAW_BINARY=y
CONFIG_READLINE_CMD_HISTORY=y
CONFIG_READLINE_TABCOMPLETION=y
CONFIG_RPMSG_UART=y
CONFIG_RPTUN=y
CONFIG_RTC_ALARM=y
CONFIG_RTC_ARCH=y
CONFIG_RTC_DATETIME=y
CONFIG_RTC_DRIVER=y
CONFIG_RTC_IOCTL=y
CONFIG_RTC_SONG=y
CONFIG_RTC=y
CONFIG_SCHED_HPWORK=y
CONFIG_SCHED_TICKLESS_ALARM=y
CONFIG_SCHED_TICKLESS_LIMIT_MAX_SLEEP=y
CONFIG_SCHED_TICKLESS=y
CONFIG_SCHED_WAITPID=y
CONFIG_SERIAL_IFLOWCONTROL_WATERMARKS=y
CONFIG_SONG_ICACHE_BASE=0xb0030050
CONFIG_SONG_MBOX=y
CONFIG_SONG_NR_IRQS=33
CONFIG_SONG_RPTUN=y
CONFIG_STACK_COLORATION=y
CONFIG_SYSLOG_PREFIX_STRING="ap: "
CONFIG_SYSLOG_PREFIX=y
CONFIG_SYSLOG_RPMSG_WORK_DELAY=0
CONFIG_SYSLOG_RPMSG=y
CONFIG_SYSLOG_TIMESTAMP=y
CONFIG_SYSTEM_CLE=y
CONFIG_SYSTEM_TIME64=y
CONFIG_USER_ENTRYPOINT="nsh_main"
```

## configs/unicorn/fvp/defconfig
```kconfig
CONFIG_ARCH="arm"
CONFIG_ARCH_ARM_SONG=y
CONFIG_ARCH_BOARD="unicorn"
CONFIG_ARCH_BOARD_UNICORN=y
CONFIG_ARCH_CHIP_FVP_MPS2_M4=y
CONFIG_ARCH_CHIP_SONG=y
CONFIG_ARCH_STACKDUMP=y
CONFIG_ARM_MPU=y
CONFIG_ARM_SEMIHOSTING_HOSTFS=y
CONFIG_ARM_SEMIHOSTING_SYSLOG=y
CONFIG_ARMV7M_MEMCPY=y
CONFIG_ARMV7M_SYSTICK=y
CONFIG_ARMV7M_USEBASEPRI=y
CONFIG_BOARD_INITIALIZE=y
CONFIG_BOARD_INITTHREAD=y
CONFIG_BUILTIN=y
CONFIG_CLOCK_MONOTONIC=y
CONFIG_DEBUG_FEATURES=y
CONFIG_DEBUG_HARDFAULT=y
CONFIG_DEBUG_SYMBOLS=y
CONFIG_DEV_LOWCONSOLE=y
CONFIG_EXAMPLES_NSH=y
CONFIG_FS_HOSTFS=y
CONFIG_FS_PROCFS=y
CONFIG_FS_ROMFS=y
CONFIG_HEAP_COLORATION=y
CONFIG_MEMSET_OPTSPEED=y
CONFIG_NSH_ARCHROMFS=y
CONFIG_NSH_BUILTIN_APPS=y
CONFIG_NSH_LINELEN=128
CONFIG_NSH_PROMPT_STRING="fvp> "
CONFIG_NSH_READLINE=y
CONFIG_NSH_ROMFSETC=y
CONFIG_PM=y
CONFIG_RAW_BINARY=y
CONFIG_READLINE_CMD_HISTORY=y
CONFIG_READLINE_TABCOMPLETION=y
CONFIG_SCHED_CHILD_STATUS=y
CONFIG_SCHED_HAVE_PARENT=y
CONFIG_SCHED_HPNTHREADS=2
CONFIG_SCHED_HPWORK=y
CONFIG_SCHED_TICKLESS_LIMIT_MAX_SLEEP=y
CONFIG_SCHED_TICKLESS=y
CONFIG_SCHED_WAITPID=y
CONFIG_SONG_NR_IRQS=48
CONFIG_STACK_COLORATION=y
CONFIG_SYSLOG_PREFIX_STRING="fvp: "
CONFIG_SYSLOG_PREFIX=y
CONFIG_SYSLOG_TIMESTAMP=y
CONFIG_SYSTEM_CLE=y
CONFIG_SYSTEM_TIME64=y
CONFIG_TIMER_ARCH=y
CONFIG_TIMER=y
CONFIG_UNICORN_FVP=y
CONFIG_USER_ENTRYPOINT="nsh_main"
```

## configs/unicorn/sim/defconfig
```kconfig
CONFIG_ARCH_BOARD="unicorn"
CONFIG_ARCH_BOARD_UNICORN=y
CONFIG_ARCH="sim"
CONFIG_ARCH_SIM=y
CONFIG_BOARDCTL_POWEROFF=y
CONFIG_BOARD_INITIALIZE=y
CONFIG_BOARD_INITTHREAD=y
CONFIG_BUILTIN=y
CONFIG_CLOCK_MONOTONIC=y
CONFIG_DEBUG_FEATURES=y
CONFIG_DEBUG_SYMBOLS=y
CONFIG_EXAMPLES_NSH=y
CONFIG_FS_HOSTFS=y
CONFIG_FS_PROCFS=y
CONFIG_FS_ROMFS=y
CONFIG_LIB_BOARDCTL=y
CONFIG_MEMSET_OPTSPEED=y
CONFIG_NSH_ARCHROMFS=y
CONFIG_NSH_BUILTIN_APPS=y
CONFIG_NSH_LINELEN=128
CONFIG_NSH_PROMPT_STRING="sim> "
CONFIG_NSH_READLINE=y
CONFIG_NSH_ROMFSETC=y
CONFIG_READLINE_CMD_HISTORY=y
CONFIG_READLINE_TABCOMPLETION=y
CONFIG_SCHED_CHILD_STATUS=y
CONFIG_SCHED_HAVE_PARENT=y
CONFIG_SCHED_HPNTHREADS=2
CONFIG_SCHED_HPWORK=y
CONFIG_SCHED_TICKLESS=y
CONFIG_SCHED_WAITPID=y
CONFIG_SIG_SIGKILL=y
CONFIG_SIM_M32=y
CONFIG_SIM_WALLTIME=y
CONFIG_SYSLOG_PREFIX_STRING="sim: "
CONFIG_SYSLOG_PREFIX=y
CONFIG_SYSLOG_TIMESTAMP=y
CONFIG_SYSTEM_CLE=y
CONFIG_SYSTEM_TIME64=y
CONFIG_UNICORN_SIM=y
CONFIG_USER_ENTRYPOINT="nsh_main"
```

## configs/unicorn/sp/defconfig
```kconfig
CONFIG_16550_ADDRWIDTH=32
CONFIG_16550_REGWIDTH=32
CONFIG_16550_UART1_BASE=0xb00b0000
CONFIG_16550_UART1_CLOCK=1843200
CONFIG_16550_UART1_IRQ=22
CONFIG_16550_UART1_SERIAL_CONSOLE=y
CONFIG_16550_UART1=y
CONFIG_16550_UART=y
CONFIG_ALARM_ARCH=y
CONFIG_ARCH="arm"
CONFIG_ARCH_ARM_SONG=y
CONFIG_ARCH_BOARD="unicorn"
CONFIG_ARCH_BOARD_UNICORN=y
CONFIG_ARCH_CHIP_SONG=y
CONFIG_ARCH_CHIP_UNICORN_SP=y
CONFIG_ARCH_STACKDUMP=y
CONFIG_ARM_MPU=y
CONFIG_ARMV7M_USEBASEPRI=y
CONFIG_BOARD_INITIALIZE=y
CONFIG_BOARD_INITTHREAD=y
CONFIG_BUILTIN=y
CONFIG_CLOCK_MONOTONIC=y
CONFIG_EXAMPLES_NSH=y
CONFIG_FS_BINFS=y
CONFIG_FS_HOSTFS_RPMSG_SERVER=y
CONFIG_FS_HOSTFS_RPMSG=y
CONFIG_FS_HOSTFS=y
CONFIG_FS_PROCFS=y
CONFIG_HEAP_COLORATION=y
CONFIG_MBOX=y
CONFIG_NSH_BUILTIN_APPS=y
CONFIG_NSH_PROMPT_STRING="sp> "
CONFIG_NSH_READLINE=y
CONFIG_ONESHOT_SONG=y
CONFIG_ONESHOT=y
CONFIG_OPENAMP=y
CONFIG_PM=y
CONFIG_RAW_BINARY=y
CONFIG_READLINE_CMD_HISTORY=y
CONFIG_READLINE_TABCOMPLETION=y
CONFIG_RPMSG_UART=y
CONFIG_RPTUN=y
CONFIG_RTC_ALARM=y
CONFIG_RTC_ARCH=y
CONFIG_RTC_DATETIME=y
CONFIG_RTC_DRIVER=y
CONFIG_RTC_IOCTL=y
CONFIG_RTC_SONG=y
CONFIG_RTC=y
CONFIG_SCHED_HPWORK=y
CONFIG_SCHED_TICKLESS_ALARM=y
CONFIG_SCHED_TICKLESS_LIMIT_MAX_SLEEP=y
CONFIG_SCHED_TICKLESS=y
CONFIG_SCHED_WAITPID=y
CONFIG_SERIAL_IFLOWCONTROL_WATERMARKS=y
CONFIG_SERIAL_UART_ARCH_MMIO=y
CONFIG_SONG_ICACHE_BASE=0xb01500d0
CONFIG_SONG_MBOX=y
CONFIG_SONG_NR_IRQS=37
CONFIG_SONG_RNG_BASE=0xb0150000
CONFIG_SONG_RNG=y
CONFIG_SONG_RPTUN=y
CONFIG_STACK_COLORATION=y
CONFIG_SYSLOG_RPMSG_SERVER=y
CONFIG_SYSTEM_CLE=y
CONFIG_SYSTEM_CUTERM_DEFAULT_DEVICE="/dev/ttyCP"
CONFIG_SYSTEM_CUTERM=y
CONFIG_SYSTEM_TIME64=y
CONFIG_UNICORN_SP=y
CONFIG_USER_ENTRYPOINT="nsh_main"
```

## crypto/Kconfig
```kconfig
#
# For a description of the syntax of this configuration file,
# see the file kconfig-language.txt in the NuttX tools repository.
#

config CRYPTO
	bool "Crypto API support"
	default n
	---help---
		Enable or disable Crypto API features

if CRYPTO

config CRYPTO_AES
	bool "AES cipher support"
	default n

# =============================================================================
config CRYPTO_MANAGER
	bool "Cryptographic manager support"
	default n

if CRYPTO_MANAGER

config CRYPTO_MANAGER_NMODULES
	int "Number of preallocated modules"
	default 2

config CRYPTO_MANAGER_DYNMODULES
	bool "Allow more dynamically allocated modules"
	default n

choice
	prompt "Entropy source"
	default CRYPTO_MANAGER_ENTROPY_DEVRANDOM if STM32_RNG || STM32L4_RNG

config CRYPTO_MANAGER_ENTROPY_DEVRANDOM
	bool "Use system hardware based /dev/random"

config CRYPTO_MANAGER_ENTROPY_BOARD
	bool "Use board level callback to generate entropy"

endchoice

config CRYPTO_SOFTMODULE
	bool "Software cryptographic module"
	default n
	depends on CRYPTO_MANAGER

if CRYPTO_SOFTMODULE

config CRYPTO_SOFTMODULE_RAMKEYS
	int "Maximum number of volatile keys per session"
	default 4

if CRYPTO_AES

config CRYPTO_SOFTMODULE_AES
	bool "Support for AES algorithms"
	default n

endif # AES

endif # SOFTMODULE

endif # MANAGER
# =============================================================================

config CRYPTO_ALGTEST
	bool "Perform automatic crypto algorithms test on startup"
	default n

if CRYPTO_ALGTEST

config CRYPTO_AES128_DISABLE
	bool "Omit 128-bit AES tests"
	default n

config CRYPTO_AES192_DISABLE
	bool "Omit 192-bit AES tests"
	default n

config CRYPTO_AES256_DISABLE
	bool "Omit 256-bit AES tests"
	default n

endif # CRYPTO_ALGTEST

config CRYPTO_CRYPTODEV
	bool "cryptodev support"
	default n

config CRYPTO_SW_AES
	bool "Software AES library"
	default n
	---help---
		Enable the software AES library as described in
		include/nuttx/crypto/aes.h

		TODO: Adapt interfaces so that they are consistent with H/W AES
		implementations.  This needs to support up_aesinitialize() and
		aes_cypher() per include/nuttx/crypto/crypto.h.

config CRYPTO_SW_SHA256
	bool "Software SHA256 library"
	default n
	---help---
		Enable the software SHA256 library

config CRYPTO_SW_RSA
	bool "Software RSA library"
	default n
	depends on CRYPTO_SW_SHA256
	---help---
		Enable the software RSA library

config CRYPTO_SONG_SIGNATURE
	bool "Song signature verify"
	default n
	select CRYPTO_SW_SHA256
	select CRYPTO_SW_RSA
	---help---
		Enable the song signature support

config CRYPTO_BLAKE2S
	bool "BLAKE2s hash algorithm"
	default n
	---help---
		Enable the BLAKE2s hash algorithm

config CRYPTO_RANDOM_POOL
	bool "Entropy pool and strong randon number generator"
	default n
	select CRYPTO_BLAKE2S
	---help---
		Entropy pool gathers environmental noise from device drivers,
		user-space, etc., and returns good random numbers, suitable
		for cryptographic use. Based on entropy pool design from
		*BSDs and uses BLAKE2Xs algorithm for CSPRNG output.

		NOTE: May not actually be cyptographically secure, if
		not enough entropy is made available to the entropy pool.

if CRYPTO_RANDOM_POOL

config CRYPTO_RANDOM_POOL_COLLECT_IRQ_RANDOMNESS
	bool "Use interrupts to feed timing randomness to entropy pool"
	default y
	---help---
		Feed entropy pool with interrupt randomness from interrupt
		dispatch function 'irq_dispatch'. This adds some overhead
		for every interrupt handled.

endif # CRYPTO_RANDOM_POOL

endif # CRYPTO
```
