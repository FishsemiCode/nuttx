## arch/arm/src/song/Kconfig
```kconfig
#
# For a description of the syntax of this configuration file,
# see the file kconfig-language.txt in the NuttX tools repository.
#

comment "Song Configuration Options"

config ARCH_CHIP_SONG
	bool

choice
	prompt "Song Chip Selection"
	depends on ARCH_CHIP_SONG

config ARCH_CHIP_BANKS_CP
	bool "Banks CP"
	select SONG_CORTEXA7

config ARCH_CHIP_BANKS_RPM
	bool "Banks RPM"
	select SONG_CORTEXM4

config ARCH_CHIP_BANKS_SENSOR
	bool "Banks Sensor"
	select ARCH_HAVE_FPU
	select SONG_CORTEXM4

config ARCH_CHIP_FVP_MPS2_M4
	bool "FVP MPS2 M4"
	select ARCH_HAVE_FPU
	select SONG_CORTEXM4

config ARCH_CHIP_U1_AP
	bool "U1 AP"
	select ARCH_HAVE_FPU
	select ARCH_HAVE_RAMFUNCS
	select SONG_CORTEXM4
	select SONG_ICACHE

config ARCH_CHIP_U1_CP
	bool "U1 CP"
	select ARCH_HAVE_FPU
	select ARCH_HAVE_RAMFUNCS
	select SONG_CORTEXM4
	select SONG_ICACHE
	select SONG_COPY_TABLE
	select SONG_ZERO_TABLE

config ARCH_CHIP_U1_SP
	bool "U1 SP"
	select ARCH_HAVE_POWEROFF
	select ARCH_HAVE_RAMFUNCS
	select SONG_CORTEXM4
	select SONG_HAVE_RNG
	select SONG_ICACHE
	select SONG_COPY_TABLE

config ARCH_CHIP_U2_M4
	bool "U2 M4"
	select ARCH_HAVE_FPU
	select SONG_CORTEXM4

endchoice

config EARLY_STACKSIZE
	int "Early stack size"
	default 0

config SONG_CORTEXA7
	bool
	select ARCH_CORTEXA7
	select ARCH_HAVE_LOWVECTORS
	select ARCH_HAVE_SDRAM
	select ARM_THUMB
	select ARMV7A_HAVE_GICv2

config SONG_CORTEXM4
	bool
	select ARCH_CORTEXM4
	select ARCH_HAVE_MPU
	select ARM_HAVE_MPU_UNIFIED
	select ARMV7M_HAVE_STACKCHECK

config SONG_COPY_TABLE
	bool

config SONG_ZERO_TABLE
	bool

config SONG_ICACHE
	bool
	select ARCH_ICACHE

config SONG_ICACHE_BASE
	hex "Song icache base address"
	depends on SONG_ICACHE

config SONG_NR_IRQS
	int "Interrupt Number"

if ARCH_USE_MMU
config SONG_MPCORE_VBASE
	hex "mpcore base address"

config SONG_PGTABLE_START
	hex "pgtable base address"

config SONG_PGTABLE_VSTART
	hex "pgtable virtual base address"
	default SONG_PGTABLE_START

config SONG_DEV_START
	hex "devices base address"

config SONG_DEV_VSTART
	hex "devices virtual base address"
	default SONG_DEV_START

config SONG_DEV_SIZE
	int "devices map size"
endif
```

## arch/ceva/src/song/Kconfig
```kconfig
#
# For a description of the syntax of this configuration file,
# see the file kconfig-language.txt in the NuttX tools repository.
#

comment "Song Configuration Options"

config ARCH_CHIP_SONG
	bool

choice
	prompt "Song Chip Selection"
	depends on ARCH_CHIP_SONG

config ARCH_CHIP_ABIES_ADSP
	bool "Abies ADSP"
	select SONG_TL420

config ARCH_CHIP_BANKS_ADSP
	bool "Banks ADSP"
	select SONG_TL421

config ARCH_CHIP_U3_CPX
	bool "U3 CPX"
	select SONG_XC5

config ARCH_CHIP_V1_VDSP
	bool "V1 VDSP"
	select SONG_XM6

endchoice

config SONG_TL420
	bool
	select ARCH_TL4_VOICE
	select ARCH_TL420

config SONG_TL421
	bool
	select ARCH_HAVE_FPU
	select ARCH_HAVE_MPU
	select ARCH_TL4_VOICE
	select ARCH_TL421

config SONG_XC5
	bool
	select ARCH_HAVE_FPU
	select ARCH_XC5

config SONG_XM6
	bool
	select ARCH_HAVE_FPU
	select ARCH_XM6

config SONG_NR_IRQS
	int "Interrupt Number"

config LOGBUF_SIZE
	int "Logbuf size"
	default 1024

config VINTC_DW
	bool "DesignWare Interrupt Controller"
	select ARCH_HAVE_IRQPRIO
	select ARCH_HAVE_IRQTRIGGER
	select ARCH_HAVE_VINTC

config VINTC_DW_BASE
	hex "DW VINTC base address"
	depends on VINTC_DW
```

## arch/ceva/src/tl4/Kconfig
```kconfig
#
# For a description of the syntax of this configuration file,
# see the file kconfig-language.txt in the NuttX tools repository.
#

comment "TL4 Configuration Options"

choice
	prompt "TL4 Profile Selection"
	default ARCH_TL4_AUDIO

config ARCH_TL4_AUDIO
	bool "Audio Profile"

config ARCH_TL4_COMPAT
	bool "Compatibility Profile"

config ARCH_TL4_VOICE
	bool "Voice Profile"

endchoice
```

## arch/ceva/src/xc5/Kconfig
```kconfig
#
# For a description of the syntax of this configuration file,
# see the file kconfig-language.txt in the NuttX tools repository.
#

comment "XC5 Configuration Options"

config ARCH__BUG001
	bool "Enable bug 001 workaround"
	---help---
		Read CEVA-XC5 Bug List for more information
```

## arch/ceva/src/xm6/Kconfig
```kconfig
#
# For a description of the syntax of this configuration file,
# see the file kconfig-language.txt in the NuttX tools repository.
#

comment "XM6 Configuration Options"

config ARCH_XM6_BUG001
	bool "Enable bug 001 workaround"
	---help---
		Read CEVA-XM6 Bug List for more information

config ARCH_XM6_STACKCHECK
	bool "Check for stack overflow on each access"
	---help---
		This check uses DBG_STACK_START/DBG_STACK_END to check for a stack
		overflow within each access.
```

## arch/csky/Kconfig
```kconfig
#
# For a description of the syntax of this configuration file,
# see the file kconfig-language.txt in the NuttX tools repository.
#

if ARCH_CSKY
comment "CSKY Options"

choice
	prompt "CSKY chip selection"
	default ARCH_CHIP_SMARTL
	default ARCH_CHIP_CH2XXX

config ARCH_CHIP_SMARTL
	bool "SMARTL"
	select ARCH_CK803F
	---help---
		CSKY architectures (CK803F cores).

config ARCH_CHIP_CH2XXX
	bool "CH2XXX"
	select ARCH_CK802
	---help---
		CSKY architectures (CK802 cores).

config ARCH_CSKY_SONG
	bool "Pinecone Song"
	select ARCH_CHIP_SONG
	select ARCH_HAVE_HEAPCHECK
	select ARCH_HAVE_RESET
	select ARCH_HAVE_STACKCHECK
	---help---
		Pinecone Song(CSKY series) architectures

endchoice

config ARCH_CK803F
	bool
	select ARCH_HAVE_FPU
	default n

config ARCH_CK802
	bool
	default n

config ARCH_FAMILY
	string
	default "ck803f"		if ARCH_CK803F
	default "ck802"		if ARCH_CK802

config ARCH_CHIP
	string
	default "smartl03"	if ARCH_CHIP_SMARTL
	default "ch2201"	if ARCH_CHIP_CH2XXX
	default "song"		if ARCH_CSKY_SONG

if ARCH_CK803F
source arch/csky/src/ck803f/Kconfig
endif
if ARCH_CHIP_SMARTL
source arch/csky/src/smartl03/Kconfig
endif

if ARCH_CK802
source arch/csky/src/ck802/Kconfig
endif
if ARCH_CHIP_CH2XXX
source arch/csky/src/ch2201/Kconfig
endif
if ARCH_CSKY_SONG
source arch/csky/src/song/Kconfig
endif

endif
```

## arch/csky/src/ch2201/Kconfig
```kconfig
#
# For a description of the syntax of this configuration file,
# see the file kconfig-language.txt in the NuttX tools repository.
#

comment "CSKY CH2201 Configuration Options"

choice
	prompt "CSKY Chip Selection"
	default ARCH_CHIP_CH2201
	depends on ARCH_CHIP_CSKY

config ARCH_CHIP_CH2201
	bool "CH2201"
	select CH2201_HAVE_UART0
	---help---
		CH2201, 8K ROM, 80K SRAM, 254KB FLASH

endchoice

config CSKY_CH2201
	bool
	default y
	select CH2201_HAVE_UART0

menu "CH2201 Peripheral Support"

# These "hidden" settings determine is a peripheral option is available for the
# selection MCU

config CH2201_HAVE_UART0
	bool
	default n
	select UART0_SERIALDRIVER
	select ARCH_HAVE_SERIAL_TERMIOS

config CH2201_UART0
	bool "UART0"
	default n
	select ARCH_HAVE_UART0
	select ARCH_HAVE_SERIAL_TERMIOS
	select CH2201_UART

endmenu

config CH2201_UART
	bool

config CH2201_UART_RX_BUF_SIZE
	int "UART RX Bufer size"
	default 64
	depends on CH2201_UART
	---help---
		Size of RX buffers for CH2201 UARTs

config CH2201_UART_TX_BUF_SIZE
	int "UART TX Bufer size"
	default 64
	depends on CH2201_UART
	---help---
		Size of TX buffers for CH2201 UARTs
```

## arch/csky/src/ck802/Kconfig
```kconfig
#
# For a description of the syntax of this configuration file,
# see the file kconfig-language.txt in the NuttX tools repository.
#

comment "CK802 Configuration Options"

config CK802_CUSTOM_IRQ_SUPPORT
	bool "Has custom implementation for IRQ handling"
	default n
	---help---
		Allows overriding the standard IRQ processing as described
		in the CSKY CK802 architecture documents.  This allows architecture
		specific code to support non-standard IRQ processing in the core.
```

## arch/csky/src/ck803f/Kconfig
```kconfig
#
# For a description of the syntax of this configuration file,
# see the file kconfig-language.txt in the NuttX tools repository.
#

comment "CK803F Configuration Options"

config CK803F_CUSTOM_IRQ_SUPPORT
	bool "Has custom implementation for IRQ handling"
	default n
	---help---
		Allows overriding the standard IRQ processing as described
		in the CSKY CK803F architecture documents.  This allows architecture
		specific code to support non-standard IRQ processing in the core.
```

## arch/csky/src/smartl03/Kconfig
```kconfig
#
# For a description of the syntax of this configuration file,
# see the file kconfig-language.txt in the NuttX tools repository.
#

comment "CSKY SMARTL Configuration Options"

choice
	prompt "CSKY Chip Selection"
	default ARCH_CHIP_SMARTL03
	depends on ARCH_CHIP_SMARTL

config ARCH_CHIP_SMARTL03
	bool "SMARTL"
	select SMARTL_HAVE_UART0
	---help---
		SMARTL, 512K I-ROM, 512K D-SRAM, 8M OFFCHIP-SRAM, 128K ONCHIP-SRAM

endchoice

menu "SMARTL Peripheral Support"

# These "hidden" settings determine is a peripheral option is available for the
# selection MCU

config SMARTL_HAVE_UART0
	bool
	default n
	select UART0_SERIALDRIVER
	select ARCH_HAVE_SERIAL_TERMIOS

config SMARTL_UART0
	bool "UART0"
	default n
	select ARCH_HAVE_UART0
	select ARCH_HAVE_SERIAL_TERMIOS
	select SMARTL_UART

endmenu

config SMARTL_UART
	bool

config SMARTL_UART_RX_BUF_SIZE
	int "UART RX Bufer size"
	default 64
	depends on SMARTL_UART
	---help---
		Size of RX buffers for SMARTL UARTs

config SMARTL_UART_TX_BUF_SIZE
	int "UART TX Bufer size"
	default 64
	depends on SMARTL_UART
	---help---
		Size of TX buffers for SMARTL UARTs
```

## arch/csky/src/song/Kconfig
```kconfig
#
# For a description of the syntax of this configuration file,
# see the file kconfig-language.txt in the NuttX tools repository.
#

comment "Song Configuration Options"

config ARCH_CHIP_SONG
	bool

choice
	prompt "Song Chip Selection"
	depends on ARCH_CHIP_SONG

config ARCH_CHIP_U1_CK
	bool "U1 CK"
	select ARCH_CK802
	select SONG_ICACHE

config ARCH_CHIP_U11_CK
	bool "U11 CK"
	select ARCH_CK802
	select SONG_ICACHE

config ARCH_CHIP_U2_CK
	bool "U2 CK"
	select ARCH_CK803F
	select SONG_COPY_TABLE

endchoice

config SONG_COPY_TABLE
	bool

config SONG_ZERO_TABLE
	bool

config SONG_ICACHE
	bool
	select ARCH_ICACHE

config SONG_ICACHE_BASE
	hex "Song icache base address"
	depends on SONG_ICACHE
```

## arch/risc-v/src/song/Kconfig
```kconfig
#
# For a description of the syntax of this configuration file,
# see the file kconfig-language.txt in the NuttX tools repository.
#

comment "Song Configuration Options"

config ARCH_CHIP_SONG
	bool

choice
	prompt "Song Chip Selection"
	default ARCH_CHIP_U2_AP
	depends on ARCH_CHIP_SONG

config ARCH_CHIP_U2_AP
	bool "U2 AP"
	select ARCH_RV32IM
	select ARCH_HAVE_FPU

config ARCH_CHIP_U2_APV3
	bool "U2 APV3"
	select ARCH_RV32IM
	select ARCH_HAVE_FPU

config ARCH_CHIP_U2_AUDIO
	bool "U2 AUDIO"
	select ARCH_RV32IM

config ARCH_CHIP_U3_AP
	bool "U3 AP"
	select ARCH_RV32IM
	select ARCH_DCACHE
	select ARCH_HAVE_FPU

config ARCH_CHIP_U3_CPR
	bool "U3 CPR"
	select ARCH_RV32IM
	select ARCH_DCACHE
	select ARCH_HAVE_FPU

config ARCH_CHIP_U3_QEMU
	bool "U3 Qemu"
	select ARCH_RV32IM
	select RISCV_MTIME

config ARCH_CHIP_V1_ISP
	bool "V1 ISP"
	select ARCH_RV32IM

config ARCH_CHIP_V1_RPM
	bool "V1 RPM"
	select ARCH_RV32IM

endchoice

config EARLY_STACKSIZE
	int "Early stack size"
	default 0

config HIPRI_INTERRUPT_PRIORITY
	hex "High Priority Interrupt Priority"
	depends on ARCH_HIPRI_INTERRUPT
	default 0x0f if INTC_DW
	default 0xffffffff if INTC_PULP
	default 0xffffffff if INTC_PLIC

choice
	prompt "Song Interrupt Controller Selection"

config INTC_DW
	bool "DesignWare Interrupt Controller"
	select ARCH_HAVE_HIPRI_INTERRUPT
	select ARCH_HAVE_IRQPRIO
	select ARCH_HAVE_IRQTRIGGER

config INTC_PLIC
	bool "Platform Level Interrupt Controller"
	select ARCH_HAVE_HIPRI_INTERRUPT
	select ARCH_HAVE_IRQPRIO
	select ARCH_HAVE_IRQTRIGGER

config INTC_PULP
	bool "Pulp Event Unit"
	select ARCH_HAVE_HIPRI_INTERRUPT
	select ARCH_HAVE_IRQPRIO

endchoice

config INTC_DW_BASE
	hex "DW VINTC base address"
	depends on INTC_DW

config INTC_PLIC_BASE
	hex "Plic base address"
	depends on INTC_PLIC

config INTC_PULP_BASE
	hex "Pulp Event Unit base address"
	depends on INTC_PULP

config RISCV_MTIME
	bool

config SONG_DCACHE_LINEBYTES
	int "Data cache line bytes"
	depends on ARCH_DCACHE

config SONG_COPY_TABLE
	bool

config SONG_NR_IRQS
	int "Interrupt Number"
```

## configs/abies/Kconfig
```kconfig
#
# For a description of the syntax of this configuration file,
# see the file kconfig-language.txt in the NuttX tools repository.
#

choice
	prompt "Select target application"

config ABIES_AUDIO
	bool "Abies Audio"

endchoice
```

## configs/abies/audio/defconfig
```kconfig
CONFIG_ALARM_ARCH=y
CONFIG_ARCH_BOARD="abies"
CONFIG_ARCH_BOARD_ABIES=y
CONFIG_ARCH="ceva"
CONFIG_ARCH_CEVA=y
CONFIG_ARCH_CHIP_ABIES_ADSP=y
CONFIG_ARCH_CHIP_SONG=y
CONFIG_ARCH_DEFAULT_HEAP=1
CONFIG_ARCH_DTCM_SIZE=131072
CONFIG_ARCH_HARDFAULT_IRQ=4
CONFIG_ARCH_ICACHE=y
CONFIG_ARCH_ITCM_SIZE=131072
CONFIG_ARCH_NR_MEMORY=2
CONFIG_ARCH_RTL_MAJOR=1
CONFIG_ARCH_RTL_MINOR=1
CONFIG_ARCH_RTL_REVISION=2
CONFIG_ARCH_STACKDUMP=y
CONFIG_ARCH_TL4_VOICE=y
CONFIG_BOARD_INITIALIZE=y
CONFIG_BOARD_INITTHREAD=y
CONFIG_BOOT_RUNFROMISRAM=y
CONFIG_BUILTIN=y
CONFIG_CLOCK_MONOTONIC=y
CONFIG_DEBUG_FEATURES=y
CONFIG_DEBUG_HARDFAULT=y
CONFIG_EXAMPLES_NSH=y
CONFIG_FS_HOSTFS_RPMSG=y
CONFIG_FS_HOSTFS=y
CONFIG_FS_PROCFS=y
CONFIG_FS_ROMFS=y
CONFIG_HEAP_COLORATION=y
CONFIG_MBOX=y
CONFIG_NSH_ARCHROMFS=y
CONFIG_NSH_BUILTIN_APPS=y
CONFIG_NSH_LINELEN=128
CONFIG_NSH_PROMPT_STRING="audio> "
CONFIG_NSH_READLINE=y
CONFIG_NSH_ROMFSETC=y
CONFIG_ONESHOT_SONG=y
CONFIG_ONESHOT=y
CONFIG_OPENAMP=y
CONFIG_PM=y
CONFIG_READLINE_CMD_HISTORY=y
CONFIG_READLINE_TABCOMPLETION=y
CONFIG_RPMSG_UART=y
CONFIG_RPTUN=y
CONFIG_RTC_ARCH=y
CONFIG_RTC_DATETIME=y
CONFIG_RTC_DRIVER=y
CONFIG_RTC_EXTERNAL=y
CONFIG_RTC_RPMSG=y
CONFIG_RTC=y
CONFIG_SCHED_CHILD_STATUS=y
CONFIG_SCHED_HAVE_PARENT=y
CONFIG_SCHED_HPNTHREADS=2
CONFIG_SCHED_HPWORK=y
CONFIG_SCHED_TICKLESS_ALARM=y
CONFIG_SCHED_TICKLESS_LIMIT_MAX_SLEEP=y
CONFIG_SCHED_TICKLESS=y
CONFIG_SCHED_WAITPID=y
CONFIG_SERIAL_IFLOWCONTROL_WATERMARKS=y
CONFIG_SIG_SIGKILL=y
CONFIG_SONG_MBOX=y
CONFIG_SONG_NR_IRQS=30
CONFIG_SONG_RPTUN=y
CONFIG_STACK_COLORATION=y
CONFIG_SYSLOG_PREFIX_STRING="audio: "
CONFIG_SYSLOG_PREFIX=y
CONFIG_SYSLOG_RPMSG=y
CONFIG_SYSLOG_TIMESTAMP=y
CONFIG_SYSTEM_CLE=y
CONFIG_SYSTEM_TIME64=y
CONFIG_USER_ENTRYPOINT="nsh_main"
CONFIG_VINTC_DW_BASE=0xf9010000
CONFIG_VINTC_DW=y
```

## configs/banks/Kconfig
```kconfig
#
# For a description of the syntax of this configuration file,
# see the file kconfig-language.txt in the NuttX tools repository.
#

choice
	prompt "Select target application"

config BANKS_AUDIO
	bool "Banks Audio"

config BANKS_RPM
	bool "Banks RPM"

config BANKS_SENSOR
	bool "Banks Sensor"

config BANKS_VISION
	bool "Banks Vision"

endchoice
```

## configs/banks/rpm/defconfig
```kconfig
CONFIG_ALARM_ARCH=y
CONFIG_ARCH="arm"
CONFIG_ARCH_ARM_SONG=y
CONFIG_ARCH_BOARD="banks"
CONFIG_ARCH_BOARD_BANKS=y
CONFIG_ARCH_CHIP_BANKS_RPM=y
CONFIG_ARCH_CHIP_SONG=y
CONFIG_ARMV7M_USEBASEPRI=y
CONFIG_BOARD_INITIALIZE=y
CONFIG_BOARD_INITTHREAD=y
CONFIG_BUILTIN=y
CONFIG_CLOCK_MONOTONIC=y
CONFIG_EXAMPLES_NSH=y
CONFIG_FS_BINFS=y
CONFIG_FS_HOSTFS_RPMSG=y
CONFIG_FS_HOSTFS=y
CONFIG_MBOX=y
CONFIG_NSH_BUILTIN_APPS=y
CONFIG_NSH_READLINE=y
CONFIG_ONESHOT_SONG=y
CONFIG_ONESHOT=y
CONFIG_OPENAMP=y
CONFIG_RAW_BINARY=y
CONFIG_RPMSG_UART=y
CONFIG_RPTUN=y
CONFIG_RTC_ARCH=y
CONFIG_RTC_DRIVER=y
CONFIG_RTC_EXTERNAL=y
CONFIG_RTC_RPMSG=y
CONFIG_RTC=y
CONFIG_SCHED_HPNTHREADS=2
CONFIG_SCHED_HPWORK=y
CONFIG_SCHED_TICKLESS_ALARM=y
CONFIG_SCHED_TICKLESS_LIMIT_MAX_SLEEP=y
CONFIG_SCHED_TICKLESS=y
CONFIG_SERIAL_IFLOWCONTROL_WATERMARKS=y
CONFIG_SONG_MBOX=y
CONFIG_SONG_NR_IRQS=51
CONFIG_SONG_RPTUN=y
CONFIG_SYSLOG_PREFIX_STRING="rpm: "
CONFIG_SYSLOG_PREFIX=y
CONFIG_SYSLOG_RPMSG=y
CONFIG_SYSLOG_TIMESTAMP=y
CONFIG_SYSTEM_CLE=y
CONFIG_SYSTEM_TIME64=y
CONFIG_USER_ENTRYPOINT="nsh_main"
```
