## drivers/clk/Kconfig
```kconfig
menuconfig CLK
	bool "Clock management (CLK) driver interfaces"
	default n
	---help---
		The base clock drivers and clock management sets. These interfaces are used
		to enable/disable clocks and set clock rate for drivers

if CLK

config CLK_RPMSG
	bool "rpmsg clk driver"
	default n
	depends on OPENAMP
	---help---
		Rpmsg clk are proxy/master pairs clock that operate clks between client and
		server processor.

if CLK_RPMSG

config CLK_RPMSG_PRIORITY
	int "clk prmsg priority"
	default 100
	---help---
		The priority for clk rmpsg task.

config CLK_RPMSG_STACKSIZE
	int "clk rpmsg stack size"
	default 1024
	---help---
	The stack size allocated for the clk rpmsg task.

endif

menuconfig SONG_CLK
	bool "song clk driver and wrapper for basic clks"
	default n
	depends on ARCH_CHIP_SONG
	---help---
		Sng clk contain song platfrom clk module (clk-pll) and clk wrapper (song-clk)
		for all basic clks

if SONG_CLK
source drivers/clk/song/Kconfig
endif # SONG_CLK

endif
```

## drivers/clk/song/Kconfig
```kconfig
if SONG_CLK

config DEBUG_SONG_CLK
	bool "enable pclks"
	default n
	depends on DEBUG_CLK
	---help---
		Showing song platform clks to enable and debug clk issues.
		Include pclks and lower power clks

endif
```

## drivers/crashdump/Kconfig
```kconfig
#
# For a description of the syntax of this configuration file,
# see the file kconfig-language.txt in the NuttX tools repository.
#

config CRASH_DUMPFILE
	bool "Enable crash dump file"
	default n
	depends on !DISABLE_MOUNTPOINT

if CRASH_DUMPFILE

config CRASH_DUMPFILE_MOUNTPOINT
	string "Mountpoint of the crash dump file"
	default "/log"

config CRASH_DUMPFILE_NUM
	int "max dump file num"
	default 10

endif # CRASH_DUMPFILE

config CRASH_DUMPZMODEM
	bool "Enable crash dump zmodem"
	default n
	depends on SYSTEM_ZMODEM
	select BOARD_CRASHDUMP

if CRASH_DUMPZMODEM

config CRASH_DUMPZMODEM_FILE
	string "FILE NAME of the crash dump zmodem"
	default "/data/crashdump.tcm"

config CRASH_DUMPZMODEM_TTY
	string "Which tty ZMODEM should use"
	default "/dev/ttyS0"

endif #CRASH_DUMPZMODEM
```

## drivers/dma/Kconfig
```kconfig
#
# For a description of the syntax of this configuration file,
# see the file kconfig-language.txt in the NuttX tools repository.
#

menuconfig DMA
	bool "DMA driver interfaces"
	default n
	select ARCH_DMA
	---help---
		Drivers for various DMA devices.

if DMA

config DMA_LINK
	bool "Support DMA link configure"

config SONG_DMAG
	bool "Song DMAG"
	depends on ARCH_CHIP_SONG
	depends on CLK

if SONG_DMAG

config SONG_DMAG_LINK
	bool "Support Song DMAG link configure"
	default n
	select DMA_LINK

if SONG_DMAG_LINK

config SONG_DMAG_RAM_OFFSET
	hex "DMAG RAM offset"
	default 0x800

config SONG_DMAG_CH_RAM_SIZE
	hex "DMAG IRAM size for each channel"
	default 0x40

config SONG_DMAG_DST_CH_RAM_SIZE
	hex "DMAG IRAM size for destination channel"
	default 0x10

endif

endif

config SONG_DMAS
	bool "Song DMAS"
	depends on ARCH_CHIP_SONG
	depends on CLK

endif
```

## drivers/hwspinlock/Kconfig
```kconfig
#
# For a description of the syntax of this configuration file,
# see the file kconfig-language.txt in the NuttX tools repository.
#

menuconfig HWSPINLOCK
	bool "HWSPINLOCK Driver Support"
	default n
	---help---
		HWSPINLOCK driver is used for multi-cores' resource access.

if HWSPINLOCK

config SONG_HWSPINLOCK
	bool "SONG SPINLOCK"
	default n
	depends on ARCH_CHIP_SONG

endif # HWSPINLOCK
```

## drivers/mbox/Kconfig
```kconfig
#
# For a description of the syntax of this configuration file,
# see the file kconfig-language.txt in the NuttX tools repository.
#

menuconfig MBOX
	bool "MAILBOX Driver Support"
	default n
	---help---
		Mailbox driver is used for multi-cores' communication.

if MBOX

config SONG_MBOX
	bool "Song Mbox Support"
	default n
	depends on ARCH_CHIP_SONG

endif # MBOX
```

## drivers/misc/Kconfig
```kconfig
#
# For a description of the syntax of this configuration file,
# see the file kconfig-language.txt in the NuttX tools repository.
#

if MISC

config MISC_RPMSG
	bool "Misc rpmsg"
	default y
	depends on OPENAMP
	select SCHED_HPWORK
	---help---
		This selection enables misc_rpmsg, for someone wanted control
		remote core do something, then can use this driver.

endif
```

## drivers/pinctrl/Kconfig
```kconfig
#
# For a description of the syntax of this configuration file,
# see the file kconfig-language.txt in the NuttX tools repository.
#

menuconfig PINCTRL
	bool "PINCTRL Driver Support"
	default n
	---help---
		This selection enables selection of common PINCTRL options.  This option
		should be enabled by all platforms that support PINCTRL interfaces.
		See include/nuttx/pinctrl/pinctrl.h for further PINCTRL driver information.

if PINCTRL

menuconfig SONG_PINCTRL
	bool "song pinctrl driver"
	default n
	depends on ARCH_CHIP_SONG
	---help---
		Sng platform pinctrl driver for pinctrl framework

endif # PINCTRL
```

## drivers/rptun/Kconfig
```kconfig
#
# For a description of the syntax of this configuration file,
# see the file kconfig-language.txt in the NuttX tools repository.
#

menuconfig RPTUN
	bool "Remote Proc Tunnel Driver Support"
	default n
	depends on OPENAMP
	---help---
		RPTUN driver is used for multi-cores' communication.

if RPTUN

config RPTUN_PRIORITY
	int "rpturn thread priority"
	default 224

config RPTUN_STACKSIZE
	int "rptun stack size"
	default 2048

config RPTUN_USE_HPWORK
	bool "rptun use HPWORK"
	default n
	depends on SCHED_HPWORK

config RPTUN_VDEV_NUM
	int "rpturn virtio device number"
	default 2

config SONG_RPTUN
	bool "Song Tunnel Support"
	default n
	depends on ARCH_CHIP_SONG
	depends on SONG_MBOX

endif # RPTUN
```

## fs/littlefs/Kconfig
```kconfig
config FS_LITTLEFS
	bool "LITTLEFS File System"
	default n
	depends on !DISABLE_MOUNTPOINT
	---help---
		Build the LITTLEFS file system. https://github.com/ARMmbed/littlefs.

if FS_LITTLEFS

config LITTLEFS_WEARLEVEL_THRESTHOLD
	int "number of blocks the littlefs start wear-leveling"
	default 4096

config LITTLEFS_MIGRATE
	bool "enable migration(from a pervious version) when mount fail"
	default n

endif
```

## fs/partition/Kconfig
```kconfig
#
# For a description of the syntax of this configuration file,
# see the file kconfig-language.txt in the NuttX tools repository.
#

if !DISABLE_MOUNTPOINT

menu "Partition Table"
endmenu

endif
```

## libs/libc/dllfcn/Kconfig
```kconfig
#
# For a description of the syntax of this configuration file,
# see the file kconfig-language.txt in the NuttX tools repository.
#

# menu "Shared Library Support"

config LIBC_DLLFCN
	bool "Shared library support"
	default n
	select LIBC_MODLIB if BUILD_PROTECTED
	select MODULE if BUILD_FLAT
	depends on !BUILD_KERNEL
	---help---
		Enabled support for user-space shared libraries.

# endmenu # Shared Library Support
```

## openamp/Kconfig
```kconfig
#
# For a description of the syntax of this configuration file,
# see the file kconfig-language.txt in the NuttX tools repository.
#

config OPENAMP
	bool "Open Asymmetric Multi Processing support"
	default n
	---help---
		Enable or disable Open Asymmetric Multi Processing features

if OPENAMP

config OPENAMP_CEVA_LOADER
	bool "OpenAMP ceva loader support"
	default y

config OPENAMP_ELF_LOADER
	bool "OpenAMP elf loader support"
	default y

endif # OPENAMP
```
